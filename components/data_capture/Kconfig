## components/data_capture/Kconfig
```kconfig
menu "Car data capture"
    config CAR_RPM_CAPTURE_HZ
        int "RPM logging poll rate (Hz)"
        range 10 200
        default 100
        help
            Poll the latest DShot feedback at this rate. Log only new samples,
            retaining the original reply timestamp. Intermediate replies can
            be missed; this does not capture every DShot frame. RC telemetry
            remains at 10 Hz.

    config CAR_WHEEL_DIAMETER_MM
        int "Wheel diameter (mm)"
        range 1 1000
        default 68
        help
            Rolling wheel diameter used for the RPM-based ground-speed estimate.

    config CAR_MOTOR_REVOLUTIONS_PER_WHEEL_X100
        int "Motor revolutions per wheel revolution (x100)"
        range 1 100000
        default 177
        help
            Gear reduction multiplied by 100. A value of 177 means 1.77 motor
            revolutions per wheel revolution; 100 means direct drive.
endmenu
```

## components/recording/Kconfig
```kconfig
menu "Car recording"
    config CAR_LOG_QUEUE_RECORDS
        int "Maximum queued records"
        range 64 512
        default 128
        help
            Producers enqueue without waiting for SD. Exhaustion records a
            dropout instead of blocking vehicle control.
endmenu
```

## components/storage/Kconfig
```kconfig
menu "Car SD storage"
    config CAR_SD_CLOCK_KHZ
        int "SD SPI clock (kHz)"
        range 400 20000
        default 20000

    config CAR_SD_READ_WRITE_TEST
        bool "Run SD read/write verification at boot"
        default n
        help
            After sensor startup, write and sync a new test file, read back
            every byte and remove that file on success. Existing files are
            never overwritten. Prints transfer rates, worst write/read/sync
            times and IMU update gaps. Disable after bench validation.

    config CAR_SD_TEST_SIZE_KIB
        int "SD verification file size (KiB)"
        depends on CAR_SD_READ_WRITE_TEST
        range 64 65536
        default 1024

    config CAR_SD_TEST_TRANSFER_BYTES
        int "SD verification transfer size (bytes)"
        depends on CAR_SD_READ_WRITE_TEST
        range 512 4096
        default 4096
endmenu
```

## components/vehicle/Kconfig
```kconfig
menu "Car yaw-rate steering"
    config CAR_YAW_RATE_MAX_DEG_S
        int "Full-stick yaw rate (degrees/second)"
        range 1 720
        default 90
        help
            Requested body yaw rate at full steering input in CH14 low/mid.
            CH6 continues to limit physical servo travel.

    config CAR_YAW_RATE_PROPORTIONAL_X1000
        int "Yaw-rate P gain (x1000)"
        range 0 10000
        default 250
        help
            Normalized steering output per rad/s of yaw-rate error, multiplied
            by 1000. Start by tuning P with the I gain set to zero.

    config CAR_YAW_RATE_INTEGRAL_X1000
        int "Yaw-rate I gain (x1000)"
        range 0 10000
        default 100
        help
            Normalized steering output per accumulated radian of yaw-rate
            error, multiplied by 1000. Only accumulates with motor motion.

    config CAR_YAW_RATE_DERIVATIVE_X1000
        int "Yaw-rate D gain (x1000)"
        range 0 10000
        default 0
        help
            Derivative of measured yaw rate, with a low-pass filter. Zero
            disables D. Changing the requested yaw rate does not cause D kick.

    config CAR_YAW_RATE_DERIVATIVE_CUTOFF_HZ
        int "Yaw-rate D low-pass cutoff (Hz)"
        range 1 30
        default 10

    config CAR_YAW_RATE_INTEGRAL_LIMIT_PERMILLE
        int "Maximum integral steering correction (per mille)"
        range 0 1000
        default 250
        help
            250 limits the learned correction to 25% of center-to-end steering
            travel. The CH6 travel limit and servo endpoints also apply.

    config CAR_POSITIVE_STEERING_TURNS_LEFT
        bool "Higher CH2 turns the wheels left"
        default n
        help
            Match the existing direct steering direction. Gyro Z is positive
            for left yaw. Leave disabled when higher CH2 steers right.
endmenu
```

## components/web/Kconfig
```kconfig
menu "Car Wi-Fi interface"
    config CAR_WIFI_SSID
        string "Access point name"
        default "car-2026"
    config CAR_WIFI_PASSWORD
        string "Access point password (8-63 characters)"
        default "car-2026"
    config CAR_WIFI_CHANNEL
        int "Access point channel"
        range 1 13
        default 1
endmenu
```

## sdkconfig.defaults
```kconfig
CONFIG_IDF_TARGET="esp32s3"
CONFIG_ESPTOOLPY_FLASHMODE_DIO=y
CONFIG_ESPTOOLPY_FLASHFREQ_80M=y
CONFIG_ESPTOOLPY_FLASHSIZE_16MB=y
CONFIG_ESP_DEFAULT_CPU_FREQ_MHZ_240=y
CONFIG_FREERTOS_HZ=1000
CONFIG_FREERTOS_IN_IRAM=y
CONFIG_FREERTOS_GENERATE_RUN_TIME_STATS=y
CONFIG_FREERTOS_USE_TRACE_FACILITY=y
CONFIG_FREERTOS_RUN_TIME_STATS_USING_ESP_TIMER=y
CONFIG_FREERTOS_RUN_TIME_COUNTER_TYPE_U64=y
CONFIG_ESP_MAIN_TASK_STACK_SIZE=8192
CONFIG_PARTITION_TABLE_CUSTOM=y
CONFIG_PARTITION_TABLE_CUSTOM_FILENAME="partitions.csv"
CONFIG_ESP_CONSOLE_USB_SERIAL_JTAG=y
CONFIG_BOOTLOADER_LOG_LEVEL_NONE=y
CONFIG_LOG_DEFAULT_LEVEL_INFO=y
CONFIG_LOG_MASTER_LEVEL=y

CONFIG_RCLINK_PROTOCOL_AUTO=y
CONFIG_RCLINK_UART=1
CONFIG_RCLINK_RX_PIN=16
CONFIG_RCLINK_TX_PIN=17
CONFIG_RCLINK_TIMEOUT_MS=300
CONFIG_RCLINK_DEADBAND=100
CONFIG_RCLINK_ZERO_LQ_FAILSAFE=y
CONFIG_RCLINK_HEARTBEAT_MS=0

CONFIG_DSHOT_DEFAULT_D600=y
CONFIG_DSHOT_DEFAULT_BIDIRECTIONAL=y
CONFIG_DSHOT_DEFAULT_FRAME_HZ=1000
CONFIG_DSHOT_DEFAULT_STARTUP_LOW_MS=300
CONFIG_DSHOT_DEFAULT_TASK_PRIORITY=20
CONFIG_DSHOT_DEFAULT_TASK_CORE=0
CONFIG_DSHOT_TIMING_DIAGNOSTICS=y

# UART1 is RC and UART2 is GPS; passthrough borrows UART0 on the motor pins.
CONFIG_ESC_PASSTHROUGH_UART=0

# Keep IMU processing on the sensor interrupt core.
CONFIG_ESP32_BNO08X_CB_TASK_AFFINITY=1
CONFIG_ESP32_BNO08X_DATA_PROC_TASK_AFFINITY=1
CONFIG_ESP32_BNO08X_SH2_HAL_SERVICE_TASK_AFFINITY=1

# Keep Wi-Fi service work off the DShot core.
CONFIG_ESP_WIFI_TASK_PINNED_TO_CORE_1=y
```

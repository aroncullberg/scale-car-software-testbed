## components/GPS/Kconfig.projbuild
```kconfig
menu "GPS Configuration"
    config GPS_ENABLE
        bool "Enable GPS"
        default y
        help 
            Enable the GPS module

    config GPS_UART_NUM
        int "GPS UART"
        default 2
        range 0 2
        help
            Which uart is the gps connected to

    config GPS_UART_RX
        int "RX Pin"
        default 15
        range 0 48
        help
            uart rx pin for the yeepeesss

    config GPS_UART_TX
        int "TX Pin"
        default 7
        range 0 48
        help
            uart TX pin for the yeepeesss
endmenu
```

## components/SBUS/Kconfig.projbuild
```kconfig
menu "SBUS Configuration"
    # Enable SBUS
    config SBUS_ENABLE
        bool "Enable SBUS"
        default y
        help
            Enable the SBUS component for input

    config SBUS_UART_NUM
        int "SBUS UART"
        default 1
        range 0 2
        help
            Which uart is the sbus receiver is connected to

    config SBUS_UART_RX
        int "RX Pin"
        default 18
        range 0 48
        help
            uart rx pin for the sbus receiver component

    config SBUS_UART_TX
        int "TX Pin"
        default 17
        range 0 48
        help
            uart TX pin for the sbus receiver component

    config SBUS_DEBUG_LOGGING_BOOL
        bool "Enable Debug Logging"
        default n
        help
            Enable detailed debug logging for SBUS processing

    config SBUS_DEBUG_LOGGING
        int
        default 1 if SBUS_DEBUG_LOGGING_BOOL
        default 0

    config SBUS_LOG_RAW_FRAMES_BOOL
        bool "Log Raw Frame Data"
        depends on SBUS_DEBUG_LOGGING_BOOL
        default n
        help
            Log raw SBUS frame data (warning: very verbose)

    config SBUS_LOG_RAW_FRAMES
        int
        default 1 if SBUS_LOG_RAW_FRAMES_BOOL
        default 0

        

    menu "Channel Configuration"
        # Channel 0 (Throttle)
        menu "Channel 0 (Throttle)"
            config SBUS_CH0_MIN
                int "Channel 0 Minimum Value"
                default 172
                range 0 2047
                help
                    Minimum raw value for channel 0

            config SBUS_CH0_MAX
                int "Channel 0 Maximum Value"
                default 1811
                range 0 2047
                help
                    Maximum raw value for channel 0

        endmenu

        # Channel 1
        menu "Channel 1"
            config SBUS_CH1_MIN
                int "Channel 1 Minimum Value"
                default 172
                range 0 2047
                help
                    Minimum raw value for channel 1

            config SBUS_CH1_MAX
                int "Channel 1 Maximum Value"
                default 1811
                range 0 2047
                help
                    Maximum raw value for channel 1

        endmenu

        # Channel 2
        menu "Channel 2"
            config SBUS_CH2_MIN
                int "Channel 2 Minimum Value"
                default 172
                range 0 2047
                help
                    Minimum raw value for channel 2

            config SBUS_CH2_MAX
                int "Channel 2 Maximum Value"
                default 1811
                range 0 2047
                help
                    Maximum raw value for channel 2
        endmenu

        # Channel 3
        menu "Channel 3"
            config SBUS_CH3_MIN
                int "Channel 3 Minimum Value"
                default 172
                range 0 2047
                help
                    Minimum raw value for channel 3

            config SBUS_CH3_MAX
                int "Channel 3 Maximum Value"
                default 1811
                range 0 2047
                help
                    Maximum raw value for channel 3
        endmenu

        # Channel 4
        menu "Channel 4"
            config SBUS_CH4_MIN
                int "Channel 4 Minimum Value"
                default 172
                range 0 2047
                help
                    Minimum raw value for channel 4

            config SBUS_CH4_MAX
                int "Channel 4 Maximum Value"
                default 1811
                range 0 2047
                help
                    Maximum raw value for channel 4
        endmenu

        # Channel 5
        menu "Channel 5"
            config SBUS_CH5_MIN
                int "Channel 5 Minimum Value"
                default 172
                range 0 2047
                help
                    Minimum raw value for channel 5

            config SBUS_CH5_MAX
                int "Channel 5 Maximum Value"
                default 1811
                range 0 2047
                help
                    Maximum raw value for channel 5
        endmenu

        # Channel 6
        menu "Channel 6"
            config SBUS_CH6_MIN
                int "Channel 6 Minimum Value"
                default 172
                range 0 2047
                help
                    Minimum raw value for channel 6

            config SBUS_CH6_MAX
                int "Channel 6 Maximum Value"
                default 1811
                range 0 2047
                help
                    Maximum raw value for channel 6
        endmenu

        # Channel 7
        menu "Channel 7"
            config SBUS_CH7_MIN
                int "Channel 7 Minimum Value"
                default 172
                range 0 2047
                help
                    Minimum raw value for channel 7

            config SBUS_CH7_MAX
                int "Channel 7 Maximum Value"
                default 1811
                range 0 2047
                help
                    Maximum raw value for channel 7
        endmenu

        # Channel 8
        menu "Channel 8"
            config SBUS_CH8_MIN
                int "Channel 8 Minimum Value"
                default 172
                range 0 2047
                help
                    Minimum raw value for channel 8

            config SBUS_CH8_MAX
                int "Channel 8 Maximum Value"
                default 1811
                range 0 2047
                help
                    Maximum raw value for channel 8
        endmenu

        # Channel 9
        menu "Channel 9"
            config SBUS_CH9_MIN
                int "Channel 9 Minimum Value"
                default 172
                range 0 2047
                help
                    Minimum raw value for channel 9

            config SBUS_CH9_MAX
                int "Channel 9 Maximum Value"
                default 1811
                range 0 2047
                help
                    Maximum raw value for channel 9
        endmenu

        # Channel 10
        menu "Channel 10"
            config SBUS_CH10_MIN
                int "Channel 10 Minimum Value"
                default 172
                range 0 2047
                help
                    Minimum raw value for channel 10

            config SBUS_CH10_MAX
                int "Channel 10 Maximum Value"
                default 1811
                range 0 2047
                help
                    Maximum raw value for channel 10
        endmenu

        # Channel 11
        menu "Channel 11"
            config SBUS_CH11_MIN
                int "Channel 11 Minimum Value"
                default 172
                range 0 2047
                help
                    Minimum raw value for channel 11

            config SBUS_CH11_MAX
                int "Channel 11 Maximum Value"
                default 1811
                range 0 2047
                help
                    Maximum raw value for channel 11
        endmenu

        # Channel 12
        menu "Channel 12"
            config SBUS_CH12_MIN
                int "Channel 12 Minimum Value"
                default 172
                range 0 2047
                help
                    Minimum raw value for channel 12

            config SBUS_CH12_MAX
                int "Channel 12 Maximum Value"
                default 1811
                range 0 2047
                help
                    Maximum raw value for channel 12
        endmenu

        # Channel 13
        menu "Channel 13"
            config SBUS_CH13_MIN
                int "Channel 13 Minimum Value"
                default 172
                range 0 2047
                help
                    Minimum raw value for channel 13

            config SBUS_CH13_MAX
                int "Channel 13 Maximum Value"
                default 1811
                range 0 2047
                help
                    Maximum raw value for channel 13
        endmenu

        # Channel 14
        menu "Channel 14"
            config SBUS_CH14_MIN
                int "Channel 14 Minimum Value"
                default 172
                range 0 2047
                help
                    Minimum raw value for channel 14

            config SBUS_CH14_MAX
                int "Channel 14 Maximum Value"
                default 1811
                range 0 2047
                help
                    Maximum raw value for channel 14
        endmenu

        # Channel 15
        menu "Channel 15"
            config SBUS_CH15_MIN
                int "Channel 15 Minimum Value"
                default 172
                range 0 2047
                help
                    Minimum raw value for channel 15

            config SBUS_CH15_MAX
                int "Channel 15 Maximum Value"
                default 1811
                range 0 2047
                help
                    Maximum raw value for channel 15
        endmenu
    endmenu
endmenu
```

## components/TelemetryManager/Kconfig.projbuild
```kconfig
menu "Telemetry Configuration"
    choice TELEMETRY_MODE
        prompt "Telemetry Operation Mode"
        default TELEMETRY_MODE_WIRELESS
        help
            Select the telemetry operation mode.

        config TELEMETRY_MODE_LOCAL
            bool "Local Only"
            help
                Only local telemetry processing, no wireless transmission.

        config TELEMETRY_MODE_WIRELESS
            bool "Wireless Only"
            help
                Only wireless telemetry transmission, no local processing.

        config TELEMETRY_MODE_BOTH
            bool "Both Local and Wireless"
            help
                Enable both local processing and wireless transmission.
    endchoice

    config TELEMETRY_MODE
        int
        default 0 if TELEMETRY_MODE_LOCAL
        default 1 if TELEMETRY_MODE_WIRELESS
        default 2 if TELEMETRY_MODE_BOTH

    config TELEMETRY_PEER_MAC
        string "Peer MAC Address"
        default "DC:DA:0C:2A:17:D8"
        help
            MAC address of the peer device in format XX:XX:XX:XX:XX:XX.
            This is typically the MAC address of your basestation/receiver.

    config TELEMETRY_ESP_NOW_CHANNEL
        int "ESP-NOW Channel"
        range 0 14
        default 0
        help
            Wi-Fi channel for ESP-NOW communication.
            Should match the channel used by your basestation.

    config TELEMETRY_QUEUE_SIZE
        int "Telemetry Queue Size"
        range 4 32
        default 16
        help
            Size of the telemetry queue in items.
            Larger values use more memory but can handle more burst traffic.
endmenu
```

## components/dshot_controller/Kconfig.projbuild
```kconfig
menu "DSHOT Configuration"
    choice DSHOT_PROTOCOL
        prompt "DSHOT Protocol Version"
        default DSHOT300
        help
            Select DSHOT protocol version to use.

        config DSHOT150
            bool "DSHOT150 (150kbaud)"
        config DSHOT300
            bool "DSHOT300 (300kbaud)"
        config DSHOT600
            bool "DSHOT600 (600kbaud)"
    endchoice

    menu "Motor GPIO Configuration"
        config MOTOR_FRONT_LEFT_GPIO
            int "Front Left Motor GPIO"
            range 0 48
            default 4
            help
                GPIO number for front left motor control signal.

        config MOTOR_FRONT_RIGHT_GPIO
            int "Front Right Motor GPIO"
            range 0 48
            default 5
            help
                GPIO number for front right motor control signal.

        config MOTOR_REAR_LEFT_GPIO
            int "Rear Left Motor GPIO"
            range 0 48
            default 6
            help
                GPIO number for rear left motor control signal.

        config MOTOR_REAR_RIGHT_GPIO
            int "Rear Right Motor GPIO"
            range 0 48
            default 7
            help
                GPIO number for rear right motor control signal.
    endmenu

    config DSHOT_RMT_RESOLUTION_HZ
        int "RMT Resolution (Hz)"
        range 1000000 80000000
        default 40000000
        help
            RMT peripheral resolution in Hz. Higher values give more precise timing.
            Default is 40MHz which works well for all DSHOT protocols.
endmenu
```

## components/imu/Kconfig.projbuild
```kconfig
menu "IMU Configuration"
    config IMU_ENABLE
        bool "Enable IMU"
        default y
        help 
            Enable the IMU module

    config IMU_SPI_CLK
        int "SPI CLK Pin"
        default 12
        range 0 48
        help
            pin for the spi clock

    config IMU_SPI_MISO
        int "SPI_MISO"
        default 13
        range 0 48
        help
            pin for the spi miso (Master in slave out), also called ADO on the icm20948

    config IMU_SPI_MOSI
        int "SPI_MOSI"
        default 11
        range 0 48
        help
            pin for the spi MOSI (Master out slave in), also called, SDI(?) on the icm20948

    config IMU_SPI_CS
        int "SPI_CS"
        default 10
        range 0 48
        help
            pin for the spi chip select

    config IMU_ENABLE_DLPF
        bool "Enable IMU Digital Low-Pass Filter (DLPF)"
        default n
        help
            Enable the built-in hardware Digital Low-Pass Filter (DLPF)
            for the accelerometer and gyroscope.  This can help reduce noise,
            but it also introduces latency.  It is generally recommended to
            DISABLE this when using the DMP, as the DMP performs its own
            filtering.  Only enable this if you have a specific reason to
            do so and understand the implications (increased latency,
            potential over-smoothing).
        

    config IMU_DEBUG_LOGGING
        bool "Enable Debug Logging"
        default n
        help
            Enable detailed debug logging for the IMU.  This controls
            the overall logging level; individual data types can be
            enabled/disabled below. (warnign very verbose)

    config IMU_LOG_ACCEL
        bool "Log accelerometer data"
        depends on IMU_DEBUG_LOGGING
        default n
        help
            Log linear acceleration data (accel_x, accel_y, accel_z).

    config IMU_LOG_GYRO
        bool "Log gyroscope data"
        depends on IMU_DEBUG_LOGGING
        default n
        help
            Log raw gyroscope data (gyro_x, gyro_y, gyro_z).

    config IMU_LOG_CALIBGYRO
        bool "Log calibrated gyroscope data"
        depends on IMU_DEBUG_LOGGING
        default n
        help
            Log calibrated gyroscope data (gyro_cal_x, gyro_cal_y, gyro_cal_z).

    config IMU_LOG_QUAT6
        bool "Log quat6 data"
        depends on IMU_DEBUG_LOGGING
        default n
        help
            Log Quat6 quaternion data (quat6_x, quat6_y, quat6_z).

    config IMU_LOG_QUAT9
        bool "Log quat9 data"
        depends on IMU_DEBUG_LOGGING
        default n
        help
            Log Quat9 quaternion data (quat9_x, quat9_y, quat9_z, quat9_accuracy).
endmenu
```
